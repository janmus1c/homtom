## build-env/armv4t/buildroot.defconfig
```kconfig
BR2_arm=y
BR2_arm920t=y
BR2_ARM_EABI=y
BR2_ARM_INSTRUCTIONS_ARM=y
BR2_DL_DIR="/dl"
BR2_HOST_DIR="/opt/armv4t"
BR2_TOOLCHAIN_BUILDROOT_UCLIBC=y
BR2_KERNEL_HEADERS_6_1=y
BR2_STATIC_LIBS=y
BR2_OPTIMIZE_S=y
BR2_REPRODUCIBLE=y
BR2_INIT_NONE=y
BR2_SYSTEM_BIN_SH_NONE=y
# BR2_PACKAGE_BUSYBOX is not set
# BR2_TARGET_ROOTFS_TAR is not set
```

## kernel/homtom/Kconfig.board
```kconfig
config MACH_TOMTOMGO
	bool "homtom GO 630 (TomTom GO 630 / S3C2443)"
	select S3C_DEV_HSMMC1
	select FIQ
	help
	  Homtom OS board support for the TomTom GO 630 (S3C2443).
	  Uses ATAG machine type 605 (historical MACH_TOMTOMGO) so the
	  stock bootloader can load the image. Product userspace is
	  homtom, not OpenTom/Nano-X. LCD uses classic LCDCON
	  (CONFIG_FB_S3C2410). USB gadget is S3C2443 HSUDC + g_ether.
```

## workspace/kernel-trim/homtom_trim_defconfig
```kconfig
CONFIG_SYSVIPC=y
CONFIG_IKCONFIG=m
CONFIG_IKCONFIG_PROC=y
CONFIG_LOG_BUF_SHIFT=16
CONFIG_BLK_DEV_INITRD=y
CONFIG_ARCH_MULTI_V4T=y
CONFIG_ARCH_MULTI_V5=y
# CONFIG_ARCH_MULTI_V7 is not set
CONFIG_ARCH_S3C24XX=y
CONFIG_S3C_ADC=y
# CONFIG_CPU_S3C2412 is not set
# CONFIG_CPU_S3C2416 is not set
# CONFIG_CPU_S3C2440 is not set
# CONFIG_CPU_S3C2442 is not set
CONFIG_CPU_S3C2443=y
# CONFIG_MACH_AML_M5900 is not set
# CONFIG_ARCH_BAST is not set
# CONFIG_ARCH_H1940 is not set
# CONFIG_MACH_N30 is not set
# CONFIG_MACH_OTOM is not set
# CONFIG_MACH_QT2410 is not set
# CONFIG_ARCH_SMDK2410 is not set
# CONFIG_MACH_TCT_HAMMER is not set
# CONFIG_MACH_VR1000 is not set
# CONFIG_MACH_JIVE is not set
# CONFIG_MACH_SMDK2412 is not set
# CONFIG_MACH_VSTMS is not set
# CONFIG_MACH_SMDK2416 is not set
# CONFIG_MACH_ANUBIS is not set
# CONFIG_MACH_AT2440EVB is not set
# CONFIG_MACH_MINI2440 is not set
# CONFIG_MACH_NEXCODER_2440 is not set
# CONFIG_MACH_OSIRIS is not set
# CONFIG_MACH_OSIRIS_DVS is not set
# CONFIG_MACH_RX3715 is not set
# CONFIG_ARCH_S3C2440 is not set
# CONFIG_ARCH_S3C2440 is not set
# CONFIG_MACH_NEO1973_GTA02 is not set
# CONFIG_MACH_RX1950 is not set
# CONFIG_MACH_SMDK2443 is not set
CONFIG_UNUSED_BOARD_FILES=y
CONFIG_AEABI=y
CONFIG_OABI_COMPAT=y
CONFIG_CMDLINE="init=/init rdinit=/init mem=64M@0x30000000 clk_ignore_unused ignore_loglevel user_debug=31 s3c2410_wdt.tmr_atboot=1 watchdog.open_timeout=90 g_ether.dev_addr=02:54:54:00:06:30 g_ether.host_addr=02:54:54:00:06:31"
# Bootloader passes root=/dev/mmcblk0p2 — force ours so initramfs /init always runs.
CONFIG_CMDLINE_FORCE=y
# CONFIG_CMDLINE_EXTEND is not set
# CONFIG_CMDLINE_FROM_BOOTLOADER is not set
CONFIG_FPE_NWFPE=y
CONFIG_FPE_NWFPE_XP=y
CONFIG_APM_EMULATION=m
CONFIG_MODULES=y
CONFIG_MODULE_UNLOAD=y
CONFIG_SLAB=y
CONFIG_NET=y
CONFIG_PACKET=y
CONFIG_UNIX=y
CONFIG_INET=y
CONFIG_IP_MULTICAST=y
CONFIG_BT=m
CONFIG_BT_RFCOMM=m
CONFIG_BT_RFCOMM_TTY=y
CONFIG_BT_BNEP=m
CONFIG_BT_BNEP_MC_FILTER=y
CONFIG_BT_BNEP_PROTO_FILTER=y
CONFIG_BT_HCIUART=m
CONFIG_BT_HCIUART_BCSP=y
CONFIG_BT_HCIUART_LL=y
CONFIG_BLK_DEV_LOOP=y
CONFIG_BLK_DEV_RAM=y
CONFIG_NETDEVICES=y
CONFIG_INPUT_EVDEV=y
CONFIG_INPUT_TOUCHSCREEN=y
CONFIG_INPUT_MISC=y
CONFIG_INPUT_UINPUT=m
CONFIG_SERIAL_SAMSUNG=y
CONFIG_SERIAL_SAMSUNG_CONSOLE=y
CONFIG_SERIAL_DEV_BUS=m
CONFIG_I2C_CHARDEV=m
CONFIG_I2C_S3C2410=y
CONFIG_WATCHDOG=y
CONFIG_S3C2410_WATCHDOG=y
CONFIG_FB=y
CONFIG_FB_S3C2410=y
# CONFIG_FB_S3C is not set
CONFIG_BACKLIGHT_PWM=m
CONFIG_MMC=y
CONFIG_MMC_SDHCI=y
CONFIG_MMC_SDHCI_PLTFM=y
CONFIG_MMC_SDHCI_S3C=y
CONFIG_MMC_S3C=y
CONFIG_RTC_CLASS=y
CONFIG_RTC_DRV_S3C=y
CONFIG_DMADEVICES=y
CONFIG_S3C24XX_DMAC=y
CONFIG_PWM=y
CONFIG_PWM_SAMSUNG=y
CONFIG_EXT2_FS=y
CONFIG_EXT2_FS_XATTR=y
CONFIG_EXT2_FS_POSIX_ACL=y
CONFIG_EXT2_FS_SECURITY=y
CONFIG_EXT3_FS=y
CONFIG_EXT3_FS_POSIX_ACL=y
CONFIG_MSDOS_FS=y
CONFIG_VFAT_FS=y
CONFIG_TMPFS=y
CONFIG_TMPFS_POSIX_ACL=y
CONFIG_NLS_CODEPAGE_437=y
CONFIG_NLS_CODEPAGE_850=y
CONFIG_NLS_ASCII=y
CONFIG_NLS_ISO8859_1=y
CONFIG_NLS_UTF8=m
CONFIG_DEBUG_INFO_DWARF_TOOLCHAIN_DEFAULT=y
CONFIG_DEBUG_KERNEL=y
CONFIG_MAGIC_SYSRQ=y
CONFIG_DEBUG_USER=y
CONFIG_DEBUG_LL=y

# homtom GO 630
CONFIG_MACH_TOMTOMGO=y
CONFIG_USB_GADGET=y
CONFIG_USB_S3C_HSUDC=y
CONFIG_USB_ETH=y
CONFIG_DEVTMPFS=y
CONFIG_DEVTMPFS_MOUNT=y

# kernel-trim variant
CONFIG_PRINTK_TIME=y
CONFIG_NO_HZ_IDLE=y
CONFIG_HIGH_RES_TIMERS=y
# CONFIG_LEGACY_PTYS is not set
# CONFIG_IPV6 is not set
CONFIG_I2C=y
CONFIG_BACKLIGHT_CLASS_DEVICE=y
CONFIG_DEBUG_INFO_NONE=y
CONFIG_INIT_STACK_NONE=y
# CONFIG_STACKPROTECTOR_STRONG is not set
```
